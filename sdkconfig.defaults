## sdkconfig.defaults
```kconfig
# USB TinyUSB
CONFIG_TINYUSB_ENABLED=y

# Disable all default USB classes
CONFIG_TINYUSB_CDC_ENABLED=n
CONFIG_TINYUSB_CDC_COUNT=0
CONFIG_TINYUSB_MSC_ENABLED=n
CONFIG_TINYUSB_HID_COUNT=0
CONFIG_TINYUSB_MIDI_COUNT=0
CONFIG_TINYUSB_VENDOR_COUNT=0
CONFIG_TINYUSB_BTH_ENABLED=n
CONFIG_TINYUSB_NET_MODE_NONE=y
CONFIG_TINYUSB_DFU_MODE_NONE=y

# Use our own descriptors, not the Kconfig defaults
CONFIG_TINYUSB_DESC_USE_ESPRESSIF_VID=n
CONFIG_TINYUSB_DESC_USE_DEFAULT_PID=n

# Console on UART only, NOT on USB OTG
CONFIG_ESP_CONSOLE_UART_DEFAULT=y
CONFIG_ESP_CONSOLE_SECONDARY_USB_SERIAL_JTAG=y

# Flash - board has 2MB
CONFIG_ESPTOOLPY_FLASHSIZE_2MB=y
CONFIG_ESPTOOLPY_FLASHSIZE="2MB"

# CPU and FreeRTOS
CONFIG_ESP_DEFAULT_CPU_FREQ_MHZ_240=y
CONFIG_FREERTOS_HZ=1000
```
